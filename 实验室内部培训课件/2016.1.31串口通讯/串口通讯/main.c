/*********************************************************************************
*实验名   ：串口通讯实验
*实验效果 ：
            将收到的数据发送回给计算机，可在串口助手上显示
*波特率 ：9600
*
*********************************************************************************/
#include<reg52.h>


#define uchar unsigned char //8 0-255
void UartConfiguration();

void main()
{
	UartConfiguration();
	while(1)
	{
	}

}

void UartConfiguration()
{
    TMOD=0x20;      //设置计数器1的工作方式2
	TH1=0xfd;			//设置计数器1的初值，决定波特率
	TL1=0xfd;			//设置计数器1的初值，决定波特率
	PCON=0x00;      // 波特率倍增0x00不加倍	 0x80加倍
	SCON=0x50;		//设置工作方式1 开启接受允许
	EA=1;		    //开启总中断
	ES=1;			//开启串口接受中断
	TR1=1;			//计数器1开始运行
}

void Uart() interrupt 4
{
    uchar date;

	date=SBUF;        //取出接受到的数据
	if(date == 2+0X30)
	{
		P1 = ~P1;
	}
	RI=0;			  //清除接受中断标志位
	SBUF=date;		  //接收到的数据放入发送缓存器发送
	while(!TI);        //等待发送数据完成
	TI=0;				//清除发送完成标志位

}