/*******************************************************************************
*文件名     : main.c
*作用       : 串口测试程序
*原理       : 无
********************************************************************************
*版本     作者            日期            说明
*V0.1     Njh           2015/08/05     初始版本
********************************************************************************/
#include "uart.h"
#include "intrins.h"


/*******************************************************************************
* 功能描述 : 延时函数
* 函数属性 : 外部
* 输入参数 : unsigned char x,要发送的数值
* 返回参数 : 无
* 函数详解 : 
      
*******************************************************************************/
void Delay100ms(unsigned char x)		//@11.0592MHz
{
	unsigned char i, j, k;

   for(x = x;x>0;x--)
   {
		_nop_();
		_nop_();
		i = 5;
		j = 52;
		k = 195;
		do
		{
			do
			{
				while (--k);
			} while (--j);
		} while (--i);
	}
}


void main(void)
{
	int num = 0;

	UartInit();	   //初始化串口中断
	
	while(1)
	{
		Delay100ms(10);
		num++;
		UART_Send_Byte(num+'0');	//发送字节
		UART_Send_Str("\n");
		UART_Send_Str("字符串发送成功\n");	//发送字符串
		if(num == 9)
			num = 0;
	}	

}

